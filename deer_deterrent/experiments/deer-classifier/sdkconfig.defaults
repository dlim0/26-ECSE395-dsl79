## deer_deterrent/experiments/deer-classifier/sdkconfig.defaults
```kconfig
CONFIG_IDF_TARGET="esp32s3"
CONFIG_ESPTOOLPY_FLASHSIZE_4MB=y
CONFIG_PARTITION_TABLE_CUSTOM=y
CONFIG_PARTITION_TABLE_CUSTOM_FILENAME="partitions.csv"
CONFIG_SPIRAM=y
CONFIG_SPIRAM_MODE_QUAD=y
CONFIG_SPIRAM_SPEED_80M=y
CONFIG_SPIRAM_USE_MALLOC=y
CONFIG_SPIRAM_MALLOC_ALWAYSINTERNAL=16384
CONFIG_SPIRAM_MALLOC_RESERVE_INTERNAL=65536
CONFIG_ESP_CONSOLE_USB_SERIAL_JTAG=y
CONFIG_ESP_MAIN_TASK_STACK_SIZE=12288
CONFIG_COMPILER_OPTIMIZATION_PERF=y
CONFIG_OV5640_SUPPORT=y

CONFIG_DEER_PINS_CONFIRMED=y
CONFIG_DEER_PIN_XCLK=17
CONFIG_DEER_PIN_SDA=1
CONFIG_DEER_PIN_SCL=41
CONFIG_DEER_PIN_D0=8
CONFIG_DEER_PIN_D1=12
CONFIG_DEER_PIN_D2=14
CONFIG_DEER_PIN_D3=11
CONFIG_DEER_PIN_D4=15
CONFIG_DEER_PIN_D5=9
CONFIG_DEER_PIN_D6=16
CONFIG_DEER_PIN_D7=6
CONFIG_DEER_PIN_VSYNC=2
CONFIG_DEER_PIN_HREF=18
CONFIG_DEER_PIN_PCLK=42
CONFIG_DEER_PIN_PWDN=37
CONFIG_DEER_PIN_RESET=-1
CONFIG_DEER_THRESHOLD_PERCENT=85
CONFIG_DEER_FRAME_INTERVAL_MS=500
```
